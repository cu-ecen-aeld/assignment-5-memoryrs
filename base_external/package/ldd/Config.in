## base_external/package/ldd/Config.in
```kconfig
config BR2_PACKAGE_LDD
	bool "ldd"
	help
	  Load the LDD kernel modules, including misc-modules and scull contained in the assignment-7 repository
```
